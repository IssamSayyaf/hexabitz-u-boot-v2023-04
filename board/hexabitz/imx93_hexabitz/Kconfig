## board/hexabitz/imx93_hexabitz/Kconfig
```kconfig
if TARGET_IMX93_HEXABITZ

config SYS_BOARD
    default "imx93_hexabitz"

config SYS_VENDOR
    default "hexabitz"

config SYS_CONFIG_NAME
    default "imx93_hexabitz"

choice
	prompt "Select DDR Type"
	default IMX93_EVK_LPDDR4X if TARGET_IMX93_HEXABITZ 
	

config IMX93_EVK_LPDDR4X
	bool "Using LPDDR4X Timing and PMIC voltage"
	select IMX9_LPDDR4X
	help
	  Select the LPDDR4X timing and 0.6V VDDQ

endchoice

endif
```
